// Overlay for upstream mmc driver
/dts-v1/;
/plugin/;

/ {
    compatible = "brcm,bcm2708";

    fragment@0 {
        target = <&mmc>;
        __overlay__ {
            compatible = "brcm,bcm2835-sdhci";
        };
    };
};

